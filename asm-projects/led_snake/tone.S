#define __SFR_OFFSET 0x00
#include "avr/io.h"

// Программа реализующая вывод звукого сигнала с определённой частотой, с использованием timer 1 в ATmega328p
// timer 1 это 16 битный таймер
// Вывод звука происходит изменением 0 или 1 на пине с определённой частотой
// Поэтому в обработчике события прерывания заполнения таймера будет происходит смена состояния на пине
// Каким образом указать с какой частотой звучать звуковому сигналу, вычислить числовое значение по формуле:
// 16000000/(2*N*f)-1, где 16М частота процессора, N предделитель, а f та частота с которой необходимо подать звуковой сигнал, результат выражения нужно и поместить в r17(старший) и r18(младший)

.set tone_pin, 3 // Номер пина, который будет выводить звуковой сигнал

.global startTone
.global stopTone
// Глобальное объявление метки с обработчиком прерывания, необходимо для того что компилятор видел данный адрес, а не ссылался на нулевой адрес
.global TIMER1_COMPA_vect

.section .text

// Запуск вывода звукогового сигнала по прерыванию
// tone_pin - номер пина, из которого будет выводиться звуковой сигнал
// Агрументы r17 (старший байт) и r18 (младший байт), чило до которого будет считать таймер
startTone:
    // Установка номера пина который будет отвечать за вывод звука
    sbi DDRD, tone_pin
    // Очистка регистра TCCR1A, чтобы не случилось такого, что режим таймера был бы в Z состоянии
    clr r16
    sts TCCR1A, r16
    // Режим таймера CTC (сброс при совпадении с OCR1AH + OCR1AL, где OCR1AH - старший байт, OCR1AL - младший байт), поэтому устанавливается бит WGM12 в TCCR1B
    // Также устанавливается предделитель 64 (биты CS11 и CS10)
    ldi r16, (1 << WGM12) | (1 << CS11) | (1 << CS10)
    sts TCCR1B, r16
    // Установка числа в старший байт регистра совпадения OCR1A
    mov r16, r17
    sts OCR1AH, r16
    // Установка числа в младший байт регистра совпадения OCR1A
    mov r16, r18
    sts OCR1AL, r16
    // Разрешение прерывания по совпадению A (Timer1 Compare Match A), по сути создание обработчика события
    // В регистре маски прерываний устанавливаем соответсвующее число 1 << OCIE1A (разрешение прерывания по совпаденю с OCR1A)
    lds r16, TIMSK1
    ori r16, (1 << OCIE1A)
    sts TIMSK1, r16
    // Разрешить прывания
    sei
    ret

// Обработчик прерывания по совпадению с регистром совпадния (обработчик события)
// Данное имя является зарезервированным, потом метка превращается в число в которое прыгает процессор из таблицы прерываний
TIMER1_COMPA_vect:
    // Сохранение состояния SREG(регистр флагов процессора), в стек (специальная область памяти, применяющаяся для сохранения адресов возврата при вызове подпрограмм)
    // Чтобы не потерять значение в регистре r16, необходимо сохранить его в так же в стек (r16 основной рабочий регистр в программе, его значение потерять нельзя)
    push r16
    in r16, SREG
    push r16
    // Запись 0 или 1 в соответсвующий pin, в регистре PIND
    sbi PIND, tone_pin
    // Восстановить состояние регистра SREG из стека
    // Восстановить значение регистра r16 из стека
    pop r16
    out SREG, r16
    pop r16
    reti    

// Остановка вывода звукого сигнала по прерыванию
stopTone:
    // Запрет прерываний по таймеру (удаление обработчика события)
    // В регистр TIMSK1 выполняем результат логического И с числом ~(1 << OCIE1A)
    lds r16, TIMSK1
    andi r16, ~(1 << OCIE1A)
    sts TIMSK1, r16
    // Очистка соответсвующего pin, в регистре PIND
    cbi PORTD, tone_pin
    ret