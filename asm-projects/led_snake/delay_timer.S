#define __SFR_OFFSET 0x00
#include "avr/io.h"

// Программа реализующая задержку программы через timer 2 в ATmega328p, timer 2 это 8-битный таймер

.global setupTimer
.global waitTimer

.section .text

// Настройка timer 2 на счёт до 1 миллисекунды, чтобы в программе была возможность задать задержку в миллисекундах
setupTimer:
    // Остановка таймера во время настройки
    clr r16
    sts TCCR2B, r16
    // Режим CTC (сброс при совпадении с OCR2A)
    // Установка 2-го бита в регистр настройки режима TCCR2A, режима СТС, для timer 2 бит WGM21 находится в регистре TCCR2A
    ldi r16, (1 << WGM21)
    sts TCCR2A, r16
    // Для отсчёта 1 мс, нужно посчитать 250 тиков
    // Загрузка в регистр совпадения OCR2A 249, отсчёт идёт с 0
    ldi r16, 249
    sts OCR2A, r16
    // Сброс текущего значения счётчика в регистре TCNT2
    clr r16
    sts TCNT2, r16
    // Частота работы ATmega328p 16000000 Гц
    // Устанавливается предделитель 64 (фиксированное число, бит CS22 = 1), для корректного расчёта 1 частоты тика таймера 16000000 / 64 = 250000 Гц
    ldi r16, (1 << CS22)
    // Данная команда запускает таймер
    sts TCCR2B, r16
    ret

// Delay на задержку в секундах, от 0 до 255 секунд можно указать для задержки
// Параметр функции r17, где указывается кол-во секунд
// В r18 хранится число количество 1/4 секунд
// В r19 хранится 250 миллисекунд
waitTimer:
    // Если кол-во секунд 0, переход к концу исполнения функции
    cpi r17, 0
    breq waitEnd
setSec:
    // Установка количества 1/4 секунды, промежуточное значение нужно, потому что регистры 8-битные, максимум для счёта кратных миллисекунд можно хранить число 250
    ldi r18, 4
set250Ms:
    // Установка 250 миллисекунд
    ldi r19, 250
waitLoop:
    // TIFR2 - регистр флагов таймера
    // OCF2A - номер бита, конкретное число, порог счёта timer 2, можно представить как `0010000`
    // Если счёт не завершился (флаг OCF2A не установлен в TIFR2), продолжаем цикл
    in r16, TIFR2
    sbrs r16, OCF2A
    rjmp waitLoop    
    // Сброс флага TIFR2, запись в него числа (1 << OCF2A), так работает AVR
    ldi r16, (1 << OCF2A)
    out TIFR2, r16
    // Уменьшить счётчик миллисекунд
    // Если 250 мс не прошли, продолжить цикл waitLoop
    // Команды inc и dec влияют на SREG(регистр флагов процессора), когда результат любой арифметической операции становится равным нулю, процессор автоматически устанавливает флаг Z (Zero flag) в SREG
    // brne сравнивает флаг Z, если он 0, значит будет переход по метке
    dec r19
    brne waitLoop
    // Уменьшить счётчик 1/4 секунды
    // Если 250 мс не прошли, продолжить цикл set250Ms
    dec r18
    brne set250Ms
    // Уменьшить счётчик 1 секунды
    // Если 250 мс не прошли, продолжить цикл setSec
    dec r17
    brne setSec
waitEnd:
    ret